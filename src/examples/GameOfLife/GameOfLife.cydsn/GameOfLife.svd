# CY8C5368AXI_106 register map
File version: 0.1
CY8C53
Registers are 8-bit, read-write, no defined reset value unless marked. A register's access mark holds for its fields unless they carry their own. Offsets are from the block's base; lines under a group give offsets from that group; [hi:lo] are bit positions; {n}, {i} and the like mark numbered series; 'fields as' and 'values as' point back to an identical list; <NAME> marks a mode.

## Memory map
0x00000000 PrISM_1 — PrISM
0x00000000 LCD_1_LCD_Control

## PrISM_1 — PrISM
Base 0x00000000
0x40006403 PrISM_SEED — Current seed value
0x40006413 PrISM_POLYNOM — Polynomial
0x40006423 PrISM_DENSITY0 — Pulse Density 0
0x40006433 PrISM_DENSITY1 — Pulse Density 1
0x40006443 PrISM_SEED_COPY — Start seed value

## LCD_1_LCD_Control
Base 0x00000000
0x40006473 LCD_1_LCD_Control_CONTROL_REG
